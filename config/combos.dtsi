// -*- mode: dts -*-

#define CHORD_TIMEOUT 45 	// getting false positives at 50

// note that SLOW and FAST refer to typing speed expected/supported.

#define COMBO_TIMEOUT_FAST 18
#define COMBO_PREIDLE_FAST 150

#define COMBO_TIMEOUT_SLOW 30
#define COMBO_PREIDLE_SLOW 50
#define COMBO_PREIDLE_SUPERSLOW 150

#define COMBO_TIMEOUT_LESSSLOW 30
#define COMBO_PREIDLE_LESSSLOW 60



#define ZMK_COMBO_SIMPLE(name, keycode, pos1, pos2) \
/ { \
    combos { \
	compatible = "zmk,combos"; \
        combo_##name { \
            timeout-ms = <CHORD_TIMEOUT>; \
	    key-positions = <pos1 pos2>; \
            bindings = <&kp keycode>; \
            require-prior-idle-ms = <COMBO_PREIDLE_SLOW>; \
        }; \
    }; \
};

#define ZMK_COMBO_LAYERS(name, keycode, pos1, pos2, layer_list) \
/ { \
    combos { \
        compatible = "zmk,combos"; \
    combo_##name { \
        timeout-ms = <CHORD_TIMEOUT>; \
        key-positions = <pos1 pos2>; \
        bindings = <&kp keycode>; \
        layers = <layer_list>; \
        require-prior-idle-ms = <COMBO_PREIDLE_SLOW>; \
    }; \
    }; \
};


#define ZMK_COMBO_FAST(name, keycode, pos1, pos2) \
/ { \
    combos { \
        compatible = "zmk,combos"; \
		combo_##name { \
        timeout-ms = <COMBO_TIMEOUT_FAST>; \
        key-positions = <pos1 pos2>; \
        bindings = <&kp keycode>; \
        require-prior-idle-ms = <COMBO_PREIDLE_FAST>; \
    }; \
    }; \
    };

#define ZMK_COMBO_SLOW(name, keycode, pos1, pos2) \
/ { \
    combos { \
        compatible = "zmk,combos"; \
    combo_##name { \
        timeout-ms = <COMBO_TIMEOUT_SLOW>; \
        key-positions = <pos1 pos2>; \
        bindings = <&kp keycode>; \
        require-prior-idle-ms = <COMBO_PREIDLE_SLOW>; \
    }; \
}; \
};

#define ZMK_COMBO_LESSSLOW(name, keycode, pos1, pos2) \
/ { \
    combos { \
        compatible = "zmk,combos"; \
    combo_##name { \
        timeout-ms = <COMBO_TIMEOUT_LESSSLOW>; \
        key-positions = <pos1 pos2>; \
        bindings = <&kp keycode>; \
        require-prior-idle-ms = <COMBO_PREIDLE_LESSSLOW>; \
    }; \
    }; \
};

#define ZMK_COMBO_PLUS(name, behavior, pos1, pos2) \
/ { \
    combos { \
        compatible = "zmk,combos"; \
    combo_##name { \
        timeout-ms = <CHORD_TIMEOUT>; \
        key-positions = <pos1 pos2>; \
        bindings = <behavior>; \
        require-prior-idle-ms = <COMBO_PREIDLE_FAST>; \
    }; \
    }; \
};

#define ZMK_COMBO_PLUS_SLOW(name, behavior, pos1, pos2) \
/ { \
    combos { \
        compatible = "zmk,combos"; \
    combo_##name { \
        timeout-ms = <COMBO_TIMEOUT_SLOW>; \
        key-positions = <pos1 pos2>; \
        bindings = <behavior>; \
        require-prior-idle-ms = <COMBO_PREIDLE_SUPERSLOW>; \
    }; \
    }; \
};

#define ZMK_COMBO_PLUS_FAST(name, behavior, pos1, pos2) \
/ { \
    combos { \
        compatible = "zmk,combos"; \
    combo_##name { \
        timeout-ms = <COMBO_TIMEOUT_FAST>; \
        key-positions = <pos1 pos2>; \
        bindings = <behavior>; \
        require-prior-idle-ms = <COMBO_PREIDLE_FAST>; \
    }; \
    }; \
};

#define ZMK_COMBO_3_PLUS(name, behavior, pos1, pos2, pos3) \
/ { \
    combos { \
        compatible = "zmk,combos"; \
    combo_##name { \
        timeout-ms = <CHORD_TIMEOUT>; \
        key-positions = <pos1 pos2 pos3>; \
        bindings = <behavior>; \
        require-prior-idle-ms = <COMBO_PREIDLE_FAST>; \
    }; \
    }; \
};

#define ZMK_COMBO_3_PLUS_SLOW(name, behavior, pos1, pos2, pos3) \
/ { \
    combos { \
        compatible = "zmk,combos"; \
    combo_##name { \
        timeout-ms = <COMBO_TIMEOUT_SLOW>; \
        key-positions = <pos1 pos2 pos3>; \
        bindings = <behavior>; \
        require-prior-idle-ms = <COMBO_PREIDLE_SLOW>; \
    }; \
    }; \
};

#define ZMK_COMBO_3_PLUS_FAST(name, behavior, pos1, pos2, pos3) \
/ { \
    combos { \
        compatible = "zmk,combos"; \
    combo_##name { \
        timeout-ms = <COMBO_TIMEOUT_FAST>; \
        key-positions = <pos1 pos2 pos3>; \
        bindings = <behavior>; \
        require-prior-idle-ms = <COMBO_PREIDLE_FAST>; \
    }; \
    }; \
};


// top row
ZMK_COMBO_FAST(esc_2, ESC, LT5, LT4)
//ZMK_COMBO_FAST(tilde_old, TILDE, LT4, LT1) // double skip (obsolete)
ZMK_COMBO_FAST(curlybracket_open, LEFT_BRACE, LT4, LT3)
ZMK_COMBO_FAST(square_open, LEFT_BRACKET, LT3, LT2)
ZMK_COMBO_FAST(paren_open, LEFT_PARENTHESIS, LT2, LT1)
ZMK_COMBO_FAST(less_than, LESS_THAN, LT1, LT0)

ZMK_COMBO_FAST(greater_than, GREATER_THAN, RT0, RT1)
ZMK_COMBO_FAST(paren_close, RIGHT_PARENTHESIS, RT1, RT2)
ZMK_COMBO_FAST(square_close, RIGHT_BRACKET, RT2, RT3)
ZMK_COMBO_FAST(curlybracket_close, RIGHT_BRACE, RT3, RT4)
ZMK_COMBO_FAST(underscore, UNDERSCORE, RT4, RT5)

ZMK_COMBO_3_PLUS(nothing, &none, LT5, LT4, LT3)

// top row skips, odd/even digits
ZMK_COMBO_PLUS(num_skip_1, &kp N1, LT3, LT1)  // skip!
ZMK_COMBO_PLUS(num_skip_2, &kp N2, RT3, RT1)  // skip!
ZMK_COMBO_PLUS(num_skip_3, &kp N3, LT4, LT2)  // skip!
ZMK_COMBO_PLUS(num_skip_4, &kp N4, RT4, RT2)  // skip!
ZMK_COMBO_PLUS(num_skip_5, &kp N5, LT2, LT0)  // skip!
ZMK_COMBO_PLUS(num_skip_6, &kp N6, RT2, RT0)  // skip!
ZMK_COMBO_PLUS(num_skip_7, &kp N7, LT5, LT3)  // skip!
ZMK_COMBO_PLUS(num_skip_8, &kp N8, RT5, RT3)  // skip!
ZMK_COMBO_PLUS(num_skip_9, &kp N9, LT0, LT3)  // double skip! does not trigger, even with keys reversed
ZMK_COMBO_PLUS(num_skip_0, &kp N0, RT3, RT0)  // double skip!


// middle row
ZMK_COMBO_PLUS_SLOW(tab_horiz, &kp TAB, LM4, LM5)
ZMK_COMBO_PLUS(alt_l, &sk LALT, LM3, LM4)
ZMK_COMBO_PLUS(caps_word_l, &caps_word_lock_dance, LM2, LM3)
ZMK_COMBO_PLUS(control_l, &sk LCTRL, LM1, LM2)
ZMK_COMBO_PLUS(enter_nav_l, &key_layer_ENTER_NAV, LM0, LM1)

ZMK_COMBO_PLUS(enter_nav_r, &key_layer_ENTER_NAV, RM0, RM1)
ZMK_COMBO_PLUS(control_r, &sk RCTRL, RM1, RM2)
ZMK_COMBO_PLUS(caps_word_r, &caps_word_lock_dance, RM2, RM3)
ZMK_COMBO_PLUS(alt_r, &sk RALT, RM3, RM4)
ZMK_COMBO_PLUS_SLOW(dash, &kp MINUS, RM4, RM5)

ZMK_COMBO_3_PLUS_FAST(emdash_alt, &em_dash, RM3, RM4, RM5)

// middle row skips

ZMK_COMBO_PLUS(smart_num_l, &smart_num_lock_dance, LM1, LM3)  // skip!
ZMK_COMBO_PLUS(smart_num_r, &smart_num_lock_dance, RM1, RM3)  // skip!
ZMK_COMBO_PLUS_FAST(gui_l, &sk LGUI, LM1, LM4)	// double skip!
ZMK_COMBO_PLUS_FAST(gui_r, &sk RGUI, RM1, RM4)	// double skip!

// cross-side

ZMK_COMBO_PLUS(tab_cross, &kp TAB, LM1, RM1)

// bottom row
ZMK_COMBO_FAST(backslash, BSLH, LB5, LB4)
//ZMK_COMBO_FAST(, , LB4, LB3)
//ZMK_COMBO_FAST(, , LB3, LB2)
//ZMK_COMBO_FAST(, , LB2, LB1)
ZMK_COMBO_FAST(minus, MINUS, LB1, LB0)
ZMK_COMBO_3_PLUS(emdash, &em_dash, LB2, LB1, LB0)


ZMK_COMBO_FAST(plus, PLUS, RB0, RB1)
ZMK_COMBO_FAST(equal, EQUAL, RB1, RB2)
ZMK_COMBO_FAST(comma, COMMA, RB2, RB3)
ZMK_COMBO_FAST(dot, DOT, RB3, RB4)
ZMK_COMBO_FAST(slash, FSLH, RB4, RB5)

// skips
//ZMK_SIMPLE_MACRO(dotcom_new, <&kp DOT>, <&kp C>, <&kp O>, <&kp M>)
ZMK_COMBO_PLUS(dotcom, &dotcom, RB1, RB4) // dot and C on hierophant

// thumbs
ZMK_COMBO_PLUS(to_hierophant, &to HIEROPHANT, LH0, RH0) // inner thumb keys
ZMK_COMBO_PLUS(navigation, &to NAVIGATION, LH1, RH1) // middle thumb keys
ZMK_COMBO_FAST(printscreen, PRINTSCREEN, LH2, RH2) // outer thumb keys; screenshot


// vertical shapes

// top two rows
ZMK_COMBO_PLUS_SLOW(grave, &kp GRAVE, LT5, LM5)
ZMK_COMBO_PLUS(excl, &kp EXCL, LT4, LM4)
ZMK_COMBO_PLUS(at, &kp AT, LM3, LT3) 
ZMK_COMBO_PLUS(hash, &kp HASH, LT2, LM2)
ZMK_COMBO_PLUS(dollar, &kp DOLLAR, LT1, LM1)
ZMK_COMBO_PLUS(tab_vert, &kp TAB, LT0, LM0)	// top and middle innermost left

ZMK_COMBO_PLUS_SLOW(backspace, &backspace_word_delete, RT0, RM0)	// top and middle innermost right
ZMK_COMBO_SLOW(amps, AMPS, RT1, RM1)
ZMK_COMBO_SLOW(asterisk, ASTERISK, RT2, RM2)
ZMK_COMBO_FAST(caret, CARET, RT3, RM3)
ZMK_COMBO_SLOW(percent, PERCENT, RT4, RM4)
ZMK_COMBO_SLOW(question, QUESTION, RT5, RM5)

// top two rows stagger
ZMK_COMBO_SLOW(del_stagger_alt, DELETE, LT0, LM2)
ZMK_COMBO_SLOW(tab_stagger, TAB, LT0, LM1)  // not comfy
ZMK_COMBO_PLUS_SLOW(backspace_stagger_l, &backspace_word_delete, LT1, LM0)
ZMK_COMBO_SLOW(tilde, TILDE, LT4, LM1)

// ⊕
ZMK_COMBO_PLUS_SLOW(delete_stagger_r, &delete_delete_word, RM0, RT1)
ZMK_COMBO_SLOW(enter_stagger, ENTER, RT0, RM1) // not comfy
ZMK_COMBO_SLOW(enter_stagger_alt, ENTER, RT0, RM2)


// bottom two rows
ZMK_COMBO_PLUS_SLOW(leader, &leader, LM5, LB5)  // middle and bottom leftmost keys
// LM4, LB4
// LM3, LB3
// LM2, LB2
// LM1, LB1
ZMK_COMBO_SLOW(menu, MENU, LM0, LB0)  // middle and bottom inner rightmost keys

// RM0, RB0
// RM1, RB1
ZMK_COMBO_SLOW(semicolon, SEMICOLON, RM2, RB2)
ZMK_COMBO_SLOW(colon, COLON, RB3, RM3) // for some reason, order of key positions is important here: reversing them means the combo does not fire.
// RB4, RM4
ZMK_COMBO_SLOW(pipe, PIPE, RM5, RB5)



// bottom row

ZMK_COMBO_PLUS_SLOW(qwerty, &to QWERTY, LB5, RB5)


// wild ones

// contractions
ZMK_COMBO_PLUS_SLOW(i_am, &i_am, LM3, RB2)
ZMK_COMBO_PLUS_SLOW(i_will, &i_will, LM3, RT3)
ZMK_COMBO_PLUS_SLOW(i_would, &i_would, LM3, RT2)
ZMK_COMBO_PLUS_SLOW(i_have, &i_have, LM3, RB0)

// for specific layers

ZMK_COMBO_LAYERS(game_lalt, LALT, LB5, LB4, GAMING)


// system layer. would have been with all six thumb keys but that is at least too many for the default config
// so this just uses the outer four
/ {
	combos {
		combo_system {
			timeout-ms = <CHORD_TIMEOUT>;
			key-positions = <LH2 LH1 RH1 RH2>;
			bindings = <&to SYSTEM>;
			require-prior-idle-ms = <LONG_PAUSE>;
		};
	};
};

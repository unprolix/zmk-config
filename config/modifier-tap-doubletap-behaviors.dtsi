// to define modifier keys which produce other behaviors with single and double taps

ht_mod_kp: ht_mod_kp {
    compatible = "zmk,behavior-hold-tap";
    #binding-cells = <2>;
    flavor = "tap-preferred";
    tapping-term-ms = <200>;
    quick-tap-ms = <125>;
    bindings = <&kp>, <&kp>;
};

backspace_word_delete: backspace_word_delete {
    compatible = "zmk,behavior-tap-dance";
    #binding-cells = <0>;
    tapping-term-ms = <TAP_DANCE_TAPPING>;
    bindings = <&kp BSPC>, <&kp LC(BSPC)>;
};

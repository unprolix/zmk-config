// -*- mode: dts -*-

#define ZMK_COMBO_SIMPLE(name, keycode, pos1, pos2) \
    combo_##name { \
        timeout-ms = <CHORD_TIMEOUT>; \
        key-positions = <pos1 pos2>; \
        bindings = <&kp keycode>; \
        require-prior-idle-ms = <PRE_CHORD_PAUSE>; \
    };


#define ZMK_COMBO_ADVANCED(name, keycode, pos1, pos2, layers, timeout, idle) \
    combo_##name { \
        timeout-ms = <timeout>; \
        key-positions = <pos1 pos2>; \
        bindings = <&kp keycode>; \
        layers = <layers>; \
        require-prior-idle-ms = <idle>; \
    };

#define ZMK_COMBO_PLUS(name, behavior, pos1, pos2) \
    combo_##name { \
        timeout-ms = <CHORD_TIMEOUT>; \
        key-positions = <pos1 pos2>; \
        bindings = <behavior>; \
        require-prior-idle-ms = <PRE_CHORD_PAUSE>; \
    };

#define ZMK_COMBO_3_PLUS(name, behavior, pos1, pos2, pos3) \
    combo_##name { \
        timeout-ms = <CHORD_TIMEOUT>; \
        key-positions = <pos1 pos2 pos3>; \
        bindings = <behavior>; \
        require-prior-idle-ms = <PRE_CHORD_PAUSE>; \
    };





/* top row */
ZMK_COMBO_SIMPLE(esc, ESC, LT5, LT4)
ZMK_COMBO_SIMPLE(tilde, TILDE, LT5, LT3)
ZMK_COMBO_SIMPLE(curlybracket_open, LEFT_BRACE, LT4, LT3)
ZMK_COMBO_SIMPLE(square_open, LEFT_BRACKET, LT3, LT2)
ZMK_COMBO_SIMPLE(paren_open, LEFT_PARENTHESIS, LT2, LT1)
ZMK_COMBO_SIMPLE(less_than, LESS_THAN, LT1, LT0)

ZMK_COMBO_SIMPLE(greater_than, GREATER_THAN, RT0, RT1)
ZMK_COMBO_SIMPLE(paren_close, RIGHT_PARENTHESIS, RT1, RT2)
ZMK_COMBO_SIMPLE(square_close, RIGHT_BRACKET, RT2, RT3)
ZMK_COMBO_SIMPLE(curlybracket_close, RIGHT_BRACE, RT3, RT4)
ZMK_COMBO_SIMPLE(underscore, UNDERSCORE, RT4, RT5)

/* middle row */
// available: LM5, LM4
ZMK_COMBO_PLUS(smart_num_l, &smart_num_lock_dance, LM4, LM3)
ZMK_COMBO_PLUS(control_l, &sk LCTRL, LM3, LM2)
ZMK_COMBO_PLUS(caps_word_l, &caps_word_lock_dance, LM2, LM1)

ZMK_COMBO_PLUS(caps_word_r, &caps_word_lock_dance, RM1, RM2)
ZMK_COMBO_PLUS(control_r, &sk RCTRL, RM2, RM3)
ZMK_COMBO_PLUS(smart_num_r, &smart_num_lock_dance, RM3, RM4)
ZMK_COMBO_SIMPLE(dash, MINUS, RM4, RM5)
ZMK_COMBO_3_PLUS(emdash_alt, &em_dash, RM3, RM4, RM5)



/* bottom row */
ZMK_COMBO_SIMPLE(backslash, BSLH, LB5, LB4)
//ZMK_COMBO_SIMPLE(, , LB4, LB3)
//ZMK_COMBO_SIMPLE(, , LB3, LB2)
//ZMK_COMBO_SIMPLE(, , LB2, LB1)
ZMK_COMBO_SIMPLE(minus, MINUS, LB1, LB0)
ZMK_COMBO_3_PLUS(emdash, &em_dash, LB2, LB1, LB0)


ZMK_COMBO_SIMPLE(plus, PLUS, RB0, RB1)
ZMK_COMBO_SIMPLE(equal, EQUAL, RB1, RB2)
ZMK_COMBO_SIMPLE(comma, COMMA, RB2, RB3)
ZMK_COMBO_SIMPLE(dot, DOT, RB3, RB4)
ZMK_COMBO_SIMPLE(slash, FSLH, RB4, RB5)



/* thumbs */
ZMK_COMBO_PLUS(base, &to BASE, LH0, RH0) /* inner thumb keys */
ZMK_COMBO_PLUS(navigation, &to NAVIGATION, LH1, RH1) /* middle thumb keys */
ZMK_COMBO_SIMPLE(printscreen, PRINTSCREEN, LH2, RH2) /* outer thumb keys; screenshot */


/* vertical shapes */

/* top two rows */
ZMK_COMBO_PLUS(grave, &kp GRAVE, LT5, LM5)
ZMK_COMBO_PLUS(excl, &kp EXCL, LT4, LM4)
ZMK_COMBO_PLUS(at, &kp AT, LT3, LM3)
ZMK_COMBO_PLUS(hash, &kp HASH, LT2, LM2)
ZMK_COMBO_PLUS(dollar, &kp DOLLAR, LT1, LM1)
ZMK_COMBO_PLUS(tab, &kp TAB, LT0, LM0)	/* top and middle innermost left */

ZMK_COMBO_SIMPLE(backspace, BSPC, RT0, RM0)	/* top and middle innermost right */
ZMK_COMBO_SIMPLE(amps, AMPS, RT1, RM1)
ZMK_COMBO_SIMPLE(asterisk, ASTERISK, RT2, RM2)
ZMK_COMBO_SIMPLE(caret, CARET, RT3, RM3)
ZMK_COMBO_SIMPLE(percent, PERCENT, RT4, RM4)
ZMK_COMBO_SIMPLE(pipe, PIPE, RT5, RM5)


/* bottom two rows */
ZMK_COMBO_PLUS(leader, &leader, LM5, LB5)  /* middle and bottom leftmost keys */
// LM4, LB4
// LM3, LB3
// LM2, LB2
// LM1, LB1
ZMK_COMBO_SIMPLE(menu, MENU, LM0, LB0)  /* middle and bottom inner rightmost keys */

// RM0, RB0
// RM1, RB1
ZMK_COMBO_SIMPLE(semicolon, SEMICOLON, RM2, RB2)
ZMK_COMBO_SIMPLE(colon, COLON, RM3, RB3)
// RM4, RB4
// RM5, RB5



// system layer. would have been with all six thumb keys but that is at least too many for the default config
// so this just uses the outer four
combo_system {
	timeout-ms = <CHORD_TIMEOUT>;
        key-positions = <LH2 LH1 RH1 RH2>;
        bindings = <&to SYSTEM>;
	require-prior-idle-ms = <LONG_PAUSE>;
};


// bootloader with far left column
combo_bootloader_left {
	timeout-ms = <CHORD_TIMEOUT>;
        key-positions = <LT5 LM5 LB5>;
        bindings = <&bootloader>;
	require-prior-idle-ms = <LONG_PAUSE>;
};
// bootloader with far right column
combo_bootloader_right {
        timeout-ms = <CHORD_TIMEOUT>;
        key-positions = <RT5 RM5 RB5>;
        bindings = <&bootloader>;
	require-prior-idle-ms = <LONG_PAUSE>;
};

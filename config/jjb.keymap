// -*- mode: dts -*-
#define HOST_OS 1 // linux. impacts unicode entry. anything else?

#include <behaviors.dtsi>
#include <behaviors/unicode.dtsi> // Requires zmk-unicode module.
#include <behaviors/num_word.dtsi> // Requires auto-layer module.
#include <dt-bindings/zmk/keys.h>

#ifdef CONFIG_WIRELESS
  #include <dt-bindings/zmk/bt.h>
  #include <dt-bindings/zmk/outputs.h>
#endif

#define KEYS_L LT0 LT1 LT2 LT3 LT4 LT5     LM0 LM1 LM2 LM3 LM4 LM5     LB0 LB1 LB2 LB3 LB4 LB5 
#define KEYS_R RT0 RT1 RT2 RT3 RT4 RT5     RM0 RM1 RM2 RM3 RM4 RM5     RB0 RB1 RB2 RB3 RB4 RB5
#define THUMBS LH2 LH1 LH0     RH0 RH1 RH2




#include "zmk-helpers/helper.h"
#include "zmk-helpers/unicode-chars/greek.dtsi"
#include "zmk-helpers/unicode-chars/french.dtsi"
#include "zmk-helpers/unicode-chars/german.dtsi"
#include "elpekenin/behaviors.dtsi"

/*
I can't get this to work but it would be great to have it work like this:

ZMK_BASE_LAYER(Base,
//╭─────────────┬─────────────┬─────────────┬─────────────┬─────────────┬─────────────╮ ╭─────────────┬─────────────┬─────────────┬─────────────┬─────────────┬─────────────╮
    &kp H          &kp E         &kp L         &kp P         &kp M          &kp E     ,     &kp I         &kp M         &kp T         &kp R        &kp A         &kp P      ,
//├─────────────┼─────────────┼─────────────┼─────────────┼─────────────┼─────────────┤ ├─────────────┼─────────────┼─────────────┼─────────────┼─────────────┤─────────────┤
    &kp H          &kp E         &kp L         &kp P         &kp M          &kp E     ,     &kp I         &kp M         &kp T         &kp R        &kp A         &kp P      ,
//├─────────────┼─────────────┼─────────────┼─────────────┼─────────────┼─────────────┤ ├─────────────┼─────────────┼─────────────┼─────────────┼─────────────┤─────────────┤
    &kp H          &kp E         &kp L         &kp P         &kp M          &kp E     ,     &kp I         &kp M         &kp T         &kp R        &kp A         &kp P      ,
//╰─────────────┴─────────────┴─────────────┼─────────────┼─────────────┼─────────────┤ ├─────────────┼─────────────┼─────────────┼─────────────┴─────────────┴─────────────╯
                                               &kp X          &kp X       &kp X       ,     &kp X          &kp X       &kp X      ,
//                                          ╰─────────────┴─────────────┴─────────────╯ ╰─────────────┴─────────────┴─────────────╯
//                             ╭─────────────╮
                                   &kp U
// ╭────────────╮ ╭────────────┼─────────────┼─────────────╮
      &kp MUTE        &kp L        &kp MUTE      &kp R
// ╰────────────╯ ╰────────────┼─────────────┼─────────────╯
                                   &kp D
//                             ╰─────────────╯
)
*/


/*

TODO:

* super specific "smart" nav keys: shift into nav, hit an arrow key: arrows stay active until a non-arrow is pressed. same or page up/page down. or should they be the same?

* how to make comma and dot combos active while smart num is active, without deactivating it?

* timing issues:
	* typing bigrams at normal speed often erroneously activates the combo on those keys. example: "re" may produce open parenthesis instead of the letters r and e.
	* typing shift singlequote to get double quote often fails and results in single quote. (opposite hand mod and key)
	* typing at normal speed often places a space after the character before which it was intended. example: "this is" might come out as "thisi s"

* hrms should pass mod to combos, esp those defined with ZMK_COMBO_SIMPLE

* try finessing timings for tap/hold/doubletap to see if it can be made non-annoying

* make layer switch combos toggle between base and the other layer?

* how to specify bluetooth-related functionality

* how to illuminate the RGB LED for a specific key

* can i rearrange the layer definitions to remove the encoder and d-pad from their current positions and place them underneath? (it's confusing to have them in the middle)

key numbers

0  1  2  3  4  5          6       7  8  9 10 11 12
13 14 15 16 17 18      19 20 21   22 23 24 25 26 27
28 29 30 31 32 33   34    35      36 37 38 39 40 41
         42 43 44                 45 46 47


 0  1  2  3  4  5          6       7  8  9 10 11 12
    q  w  e  r  t                  y  u  i  o  p  '

13 14 15 16 17 18      19 20 21   22 23 24 25 26 27
    a  s  d  f  g                  h  j  k  l  ;  '

28 29 30 31 32 33   34    35      36 37 38 39 40 41
    z  x  c  v  b                  n  m  ,  .  /

         42 43 44                 45 46 47

*/


/*
 * Pointer and scroll speed. These MUST be set before the include below:
 * pointing.h guards its defaults with #ifndef, so anything defined afterwards
 * is simply ignored and the stock 600/10 stand.
 *
 * They also have to be spelled ZMK_POINTING_*: the ZMK_MOUSE_* names these were
 * written as no longer exist, and mouse.h is now a one-line shim for pointing.h.
 * Two independent reasons the old lines did nothing, which is why the speed
 * never changed no matter what they said.
 */
#define ZMK_POINTING_DEFAULT_MOVE_VAL 1200 // stock is 600
#define ZMK_POINTING_DEFAULT_SCRL_VAL 20   // stock is 10

#include <dt-bindings/zmk/mouse.h>
#include <dt-bindings/zmk/rgb.h>

#include <input/processors.dtsi>

#define HIEROPHANT 0
#define QWERTY 1
#define GAMING 2
// Slot 3 held the CAPS layer. Caps lock needs no layer -- the lighting
// reads the host's LED report -- but the numbering below it is shared with
// rolio.keymap and toucan.keymap, so the slot stays, empty.
#define EMPTY_2 3
#define SUPERSCRIPT 4

#define NUMERIC 5
#define NUMPAD 6
#define SYMBOL 7


#define NAVIGATION 8
#define MODIFIER_LEFT_NAV 9
#define MODIFIER_RIGHT_NAV 10

#define EXTRA 11
#define FN 12

#define LIGHTING 13
#define BLUETOOTH 14
#define SYSTEM 15


// short versions for helping things line up
#define NUM NUMERIC
#define NAV NAVIGATION
#define LGUI_NAV_L MODIFIER_LEFT_NAV
#define RGUI_NAV_R MODIFIER_RIGHT_NAV
#define MENU K_APPLICATION


// which modifiers we want on which home row keys
#define L_M4 LGUI
#define L_M3 LALT
#define L_M2 LSHIFT
#define L_M1 LCTRL
//#define L_M0 N/A

//#define L_M0 N/A
#define R_M1 RCTRL
#define R_M2 RSHIFT
#define R_M3 RALT
#define R_M4 RGUI



#define TAP_TIMEOUT 50
#define TAP_DANCE_TAPPING 250  	/* 200 seemed difficult to achieve */
#define FAST_TAP 230		// at 200, the double tap actions do not reliably trigger
#define INTERRUPT_TAP 50        // very short window, for interrupting tap dance
#define HRM_PAUSE 250           // required delay before a hrm will trigger (too big: 350)
#define LONG_PAUSE 500		// e.g. before certain combos. 800 is too long. so is 600
/*

   &mmv_input_listener {
       input-processors = <&zip_xy_scaler 2 1>;
   };

   &msc_input_listener {
       input-processors = <&zip_xy_scaler 2 1>;
   };

 */

#define QUICK_TAP_MS 175



#include "macros.dtsi"



ZMK_HOLD_TAP(smart_num, bindings = <&mo>, <&num_dance>; flavor = "balanced";
             tapping-term-ms = <200>; quick-tap-ms = <QUICK_TAP_MS>;)
ZMK_TAP_DANCE(num_dance, bindings = <&num_word NUM>, <&sl_long NUM>;
              tapping-term-ms = <200>;)

// dedicated auto-layer behaviors so smart NUMPAD/SYMBOL stay active across their layer keys
/ {
    behaviors {
        numpad_word: numpad_word {
            compatible = "zmk,behavior-auto-layer";
            #binding-cells = <1>;
            continue-list = <BACKSPACE DELETE DOT COMMA PLUS MINUS STAR FSLH EQUAL BSLH SQT DQT QUESTION LESS_THAN GREATER_THAN>;
            ignore-numbers;
        };
        symbol_word: symbol_word {
            compatible = "zmk,behavior-auto-layer";
            #binding-cells = <1>;
            continue-list = <BACKSPACE DELETE SPACE TAB ESC GRAVE TILDE EXCL AT HASH DOLLAR PERCENT CARET AMPS ASTERISK LPAR RPAR MINUS UNDERSCORE EQUAL PLUS LBKT RBKT LBRC RBRC BSLH PIPE SEMI COLON SQT DQT COMMA DOT LT GT FSLH QMARK>;
        };
    };
};



#define HRM_PRIOR_IDLE 150	// increased from 80 to fix inconsistent hold activation (particularly A->LCTRL). 80 was too low, causing holds to fail when typing quickly

#define MAKE_HRM(NAME, HOLD, TAP, TRIGGER_POS)                                    \
  ZMK_HOLD_TAP(NAME, bindings = <HOLD>, <TAP>; flavor = "balanced";               \
               tapping-term-ms = <280>; quick-tap-ms = <QUICK_TAP_MS>;            \
               require-prior-idle-ms = <HRM_PRIOR_IDLE>;                          \
               hold-trigger-key-positions = <TRIGGER_POS>;)

#define HRM_SYM_TAPPING_TERM 380
#define HRM_SYM_PRIOR_IDLE 250

#define MAKE_HRM_SYM(NAME, HOLD, TAP, TRIGGER_POS)                                    \
  ZMK_HOLD_TAP(NAME, bindings = <HOLD>, <TAP>; flavor = "balanced";                   \
               tapping-term-ms = <HRM_SYM_TAPPING_TERM>; quick-tap-ms = <QUICK_TAP_MS>; \
               require-prior-idle-ms = <HRM_SYM_PRIOR_IDLE>;                          \
               hold-trigger-key-positions = <TRIGGER_POS>;)

// NUMPAD home-row mods. Both hands carry a full 0-9 on this layer, so
// cross-hand digit rolls -- the exact shape a positional hold-tap cannot
// reject -- are the common case rather than the exception. The tapping term
// stays at the base 280 (a longer one only widens the window in which a fast
// roll reads as a hold), and the guard is a raised require-prior-idle: inside a
// run of digits the mods are simply off, and they come back the moment you
// pause and reach for one deliberately. Same reasoning as HRM_SYM_PRIOR_IDLE,
// different cause.
#define HRM_PAD_PRIOR_IDLE 250

#define MAKE_HRM_PAD(NAME, HOLD, TAP, TRIGGER_POS)                                \
  ZMK_HOLD_TAP(NAME, bindings = <HOLD>, <TAP>; flavor = "balanced";               \
               tapping-term-ms = <280>; quick-tap-ms = <QUICK_TAP_MS>;            \
               require-prior-idle-ms = <HRM_PAD_PRIOR_IDLE>;                      \
               hold-trigger-key-positions = <TRIGGER_POS>;)

#define MAKE_ADAPTIVE_REPEAT(NAME, HOLD_TAP_BEHAVIOR, LAYER, KEY) \
		NAME: NAME { \
			compatible = "zmk,behavior-antecedent-morph"; \
			#binding-cells = <0>; \
			defaults = <&HOLD_TAP_BEHAVIOR LAYER KEY>; \
			bindings = <&key_repeat>; \
			antecedents = <KEY>; \
			max-delay-ms = <HRM_PAUSE>; \
		};

#define MAKE_ANTECEDENT_MORPH(NAME, DEFAULT_KEY, MORPH_KEY, ANTECEDENT_KEY) \
		NAME: NAME { \
			compatible = "zmk,behavior-antecedent-morph"; \
			#binding-cells = <0>; \
			defaults = <&kp DEFAULT_KEY>; \
			bindings = <&kp MORPH_KEY>; \
			antecedents = <ANTECEDENT_KEY>; \
			max-delay-ms = <HRM_PAUSE>; \
		};

#define MAKE_ANTECEDENT_MORPH_ADV(NAME, DEFAULT_BEHAVIOR, MORPH_BEHAVIOR, ANTECEDENT_KEY) \
		NAME: NAME { \
			compatible = "zmk,behavior-antecedent-morph"; \
			#binding-cells = <0>; \
			defaults = <DEFAULT_BEHAVIOR>; \
			bindings = <MORPH_BEHAVIOR>; \
			antecedents = <ANTECEDENT_KEY>; \
			max-delay-ms = <HRM_PAUSE>; \
		};



// Sticky key for the home-row mods, with a far longer arm window than ZMK's
// stock &sk.
//
// Arming one is already deliberate: 150ms idle before it will engage at all,
// then a 280ms hold, then a release that touches nothing. Stock &sk then gives
// you 1000ms to press the target, which is a 1-second deadline at the end of
// half a second of waiting -- too tight to aim at, and the whole point of
// arming a modifier is that you are about to do something you have to think
// about. Five seconds costs nothing: an armed modifier is visible on the strip,
// and pressing anything at all consumes it.
//
// ignore-modifiers is kept from the stock definition, so reaching for a second
// modifier does not eat the first.
ZMK_STICKY_KEY(sk_long, bindings = <&kp>; release-after-ms = <5000>; ignore-modifiers;)

// The thumb's sticky Shift, wrapped so that a Backspace after the letter it
// shifted puts it back (boards/shields/common/sticky_shift_redo.c). Only this
// one: a home-row Shift goes through &sk_long and is never re-armed.
/ {
    behaviors {
        sk_redo: sticky_shift_redo {
            compatible = "zmk,behavior-sticky-shift-redo";
            #binding-cells = <1>;
            bindings = <&sk>;
        };
    };
};

// The same for sticky LAYERS. ZMK's &sl is the identical behaviour with &mo as
// its binding, and the identical 1000ms deadline; quick-release is kept from
// the stock definition so the layer drops the moment the next key is pressed
// rather than lingering through it.
ZMK_STICKY_KEY(sl_long, bindings = <&mo>; release-after-ms = <5000>; quick-release;)

// The hold is &sk, not &kp: a sticky modifier is a SUPERSET of a held one, not
// an alternative to it. behavior_sticky_key presses its binding immediately, so
// the modifier is live for the whole hold; on release it checks whether another
// key was used in the meantime and, if so, releases there and then -- "act like
// a normal key", in its own words. Holding Ctrl across five keys or a drag is
// unchanged. What is gained is that holding and releasing WITHOUT using it arms
// the modifier for the next press instead of doing nothing.
//
// Same trick the nav thumbs use with &sl, which is why they feel like both a
// held layer and a sticky one.
//
// The cost is that a hold-then-release that was not meant to arm anything now
// poisons the following keystroke rather than just its own. If home-row mods
// start firing on the key AFTER the one that misfired, this is why, and &kp
// puts it back.
MAKE_HRM(hml, &sk_long, &kp, KEYS_R THUMBS) // Left-hand HRMs.
MAKE_HRM(hmr, &sk_long, &kp, KEYS_L THUMBS) // Right-hand HRMs.

// SUPERSCRIPT home-row mods (&sup_uc lives in layer-mod-macros.dtsi): same timings as the ordinary HRMs, but tapping
// emits a superscript instead of a letter. Without these the SUPERSCRIPT layer
// would drop every home-row mod for as long as it is toggled on.
MAKE_HRM(hml_sup, &sk_long, &sup_uc, KEYS_R THUMBS)
MAKE_HRM(hmr_sup, &sk_long, &sup_uc, KEYS_L THUMBS)

MAKE_HRM_SYM(hml_sym, &sk_long, &kp, KEYS_R THUMBS) // SYMBOL-layer left HRMs (longer term, more prior-idle).
MAKE_HRM_SYM(hmr_sym, &sk_long, &kp, KEYS_L THUMBS) // SYMBOL-layer right HRMs.

MAKE_HRM_PAD(hml_pad, &sk_long, &kp, KEYS_R THUMBS) // NUMPAD-layer left HRMs.
MAKE_HRM_PAD(hmr_pad, &sk_long, &kp, KEYS_L THUMBS) // NUMPAD-layer right HRMs.

// NUMPAD layer keys, mirroring hierophant's top row finger for finger. The
// hold bindings are the numpad_exit_* macros (layer-mod-macros.dtsi), which
// drop NUMPAD before raising their target -- see the comment there for why
// stacking is not enough.
//
// These carry HRM_PAD_PRIOR_IDLE where hierophant's sticky pair deliberately
// carries none. There the keys are Z/F/L/B, rare letters you reach for between
// words; here they are 0/1/3 and MINUS, typed in fast cross-hand runs, so the
// guard earns its place exactly as it does on the home row.
#define MAKE_PAD_LAYER(NAME, HOLD, TRIGGER_POS)                                   \
  ZMK_HOLD_TAP(NAME, bindings = <HOLD>, <&kp>; flavor = "balanced";               \
               tapping-term-ms = <280>; quick-tap-ms = <QUICK_TAP_MS>;            \
               require-prior-idle-ms = <HRM_PAD_PRIOR_IDLE>;                      \
               hold-trigger-key-positions = <TRIGGER_POS>;)

MAKE_PAD_LAYER(pad_tll, &numpad_exit_mo, KEYS_R THUMBS)        // held (SYMBOL)
MAKE_PAD_LAYER(pad_tlr, &numpad_exit_mo, KEYS_L THUMBS)
MAKE_PAD_LAYER(pad_tll_sticky, &numpad_exit_sl, KEYS_R THUMBS) // armed (EXTRA, FN)
MAKE_PAD_LAYER(pad_tlr_sticky, &numpad_exit_sl, KEYS_L THUMBS)

// NUMPAD middle thumbs. On hierophant these tap the arcane key, which does
// nothing useful among digits, and hold sticky NAV. Here the tap becomes a
// numpad key and the hold is still NAV -- but through numpad_exit_sl, because
// NAV's bottom-left row is all &trans and stacked over NUMPAD it would type
// 7 8 9 instead of hierophant's letters.
//
// Balanced rather than arcane_nav's hold-preferred. Hold-preferred reads ANY
// key pressed during the hold as a hold, so backspace-then-retype rolled a
// little late becomes NAV plus an arrow key -- an ordinary motion in numeric
// entry. Balanced only takes the hold if that other key is also RELEASED first,
// so a roll stays a tap. quick-tap keeps tap-then-hold as backspace autorepeat.
ZMK_HOLD_TAP(pad_nav, bindings = <&numpad_exit_sl>, <&kp>; flavor = "balanced";
             tapping-term-ms = <200>; quick-tap-ms = <QUICK_TAP_MS>;)

// Top Layer Left/Right: SYMBOL on U/D, NUMERIC on P/G, NUMPAD on W.
//
// Held through &sl_long rather than &mo, the same trick the home-row mods use
// with &sk_long. A sticky layer is a superset of a momentary one: held and used,
// it releases the moment the other key does, exactly like &mo; held and released
// UNUSED, it stays armed for the next key instead of doing nothing. The guards
// are MAKE_HRM's -- prior-idle and the positional restriction -- because U, D,
// P and G are common letters, unlike the Z/F/L/B that tll_sticky can leave
// unguarded.
//
// The cost is the one the HRMs already carry: a letter held too long now also
// turns the NEXT key into a symbol or digit, where before it only lost itself.
MAKE_HRM(tll, &sl_long, &kp, KEYS_R THUMBS)
MAKE_HRM(tlr, &sl_long, &kp, KEYS_L THUMBS)

// SYMBOL on U/D: tll/tlr with a shorter prior-idle. Symbols are reached for
// mid-word -- `foo(`, `x_y`, `a/b` -- so the 150ms HRM guard refused the hold
// exactly when it was wanted and typed the letter instead. The positional
// restriction still stops a same-hand roll from reading as a hold.
#define TL_SYM_PRIOR_IDLE 75

#define MAKE_TL_SYM(NAME, TRIGGER_POS)                                            \
  ZMK_HOLD_TAP(NAME, bindings = <&sl_long>, <&kp>; flavor = "balanced";           \
               tapping-term-ms = <280>; quick-tap-ms = <QUICK_TAP_MS>;            \
               require-prior-idle-ms = <TL_SYM_PRIOR_IDLE>;                       \
               hold-trigger-key-positions = <TRIGGER_POS>;)

MAKE_TL_SYM(tll_sym, KEYS_R THUMBS)
MAKE_TL_SYM(tlr_sym, KEYS_L THUMBS)

// Sticky variants of the above.
//
// The nav thumbs hold to &sl rather than &mo, which is why NAV can be held for
// one key and then let go of -- the layer survives exactly one press. Holding a
// layer down for the whole of a two-key sequence is the tiring way to do it.
//
// FUNCTION and EXTRA are reached the same way, so they get the same treatment; everything else
// about these matches tll/tlr, including the positional restriction that stops
// a same-hand roll being read as a hold.
//
// FUNCTION uses these too, but only because &sys_reset and &bootloader have
// been moved off it to SYSTEM. Armed rather than held, a single stray press of
// "," "K" "M" or "J" reached one of them -- which is how a half ended up
// sitting in its bootloader with nobody at the keyboard. Nothing on FUNCTION
// is destructive now; do not put anything destructive back.
//
// Also note: a layer entered through &sl is never seen by a momentary-layer
// driver, so anything asking "which hand is holding this layer" gets a stale
// answer for these. Harmless while the colours are symmetrical -- which is why
// NUMPAD and SYMBOL lost their one-sided lighting when tll/tlr went sticky.
// No require-prior-idle on these, unlike MAKE_HRM: arming a layer is something
// you do between words, and a guard that refuses within 150ms of the last
// keystroke refuses exactly when you reach for it mid-flow. The positional
// restriction still stands, so a same-hand roll cannot be read as a hold.
#define MAKE_HRM_STICKY(NAME, TRIGGER_POS)                                        \
  ZMK_HOLD_TAP(NAME, bindings = <&sl_long>, <&kp>; flavor = "balanced";           \
               tapping-term-ms = <280>; quick-tap-ms = <QUICK_TAP_MS>;            \
               hold-trigger-key-positions = <TRIGGER_POS>;)

MAKE_HRM_STICKY(tll_sticky, KEYS_R THUMBS)
MAKE_HRM_STICKY(tlr_sticky, KEYS_L THUMBS)

#include "build_info.dtsi"
//#include "tap-hold-layer.dtsi"

&lt {
    tapping-term-ms = <150>;
    quick-tap-ms = <150>;
    flavor = "tap-preferred";
};

&uc {
  default-mode = <UC_MODE_LINUX>;
};


#include "personal.dtsi"

/ {
  macros {
      #include "layer-mod-macros.dtsi"
      #include "emoji.dtsi"
  };
};


#include "combos.dtsi"
#include "bt-modsel.dtsi"
#include "leader.dtsi"

ZMK_UNICODE_SINGLE(em_dash, N2, N0, N1, N4)


// BT_MODSEL puts select, disconnect and clear on one key per profile, told
// apart by which modifier is held. That compresses profile management to a
// single row, which mattered when it had to share a layer. BLUETOOTH has rows
// to spare and spends them: a row of selects above a row of disconnects is
// there to be read, rather than remembered. Left instantiable, not instantiated.
//
// BT_MODSEL(0) .. BT_MODSEL(4)

#include "hierophant.dtsi"		

/ {
	behaviors {

#include "alphanumerics.dtsi"
#include "tap-hold-layer-behaviors.dtsi"
#include "modifier-tap-doubletap-behaviors.dtsi"
#include "arcane.dtsi"

// todo: remake these to be more like hml and hmr
ZMK_KEY_LAYER(SQT,NUM)
ZMK_KEY_LAYER(DQT,NUM)
ZMK_KEY_LAYER(ENTER, NAV)

		
        





dash_emdash: dash_emdash {
    compatible = "zmk,behavior-mod-morph";
    #binding-cells = <0>;
    bindings = <&kp MINUS>, <&em_dash>;
    mods = <(MOD_LSFT|MOD_RSFT)>;
};


// the morphed behavior seems to do nothing. have tried 20, 99, and 999 with MOVE_X and MOVE_Y
msc_up_variable: msc_up_variable {
    compatible = "zmk,behavior-mod-morph";
    #binding-cells = <0>;
    bindings = <&msc SCRL_UP>, <&msc MOVE_Y(20)>;
    mods = <(MOD_LSFT|MOD_RSFT)>;
};

msc_down_variable: msc_down_variable {
    compatible = "zmk,behavior-mod-morph";
    #binding-cells = <0>;
    bindings = <&msc SCRL_DOWN>, <&msc MOVE_Y(-20)>;
    mods = <(MOD_LSFT|MOD_RSFT)>;
};

smart_nav_thumb: smart_nav_thumb {
    compatible = "zmk,behavior-hold-tap";
    #binding-cells = <2>;
    flavor = "hold-preferred";
    tapping-term-ms = <200>;
    quick-tap-ms = <175>;
    bindings = <&sl_long>, <&kp>;
};

arcane_nav_l: arcane_nav_l {
    compatible = "zmk,behavior-hold-tap";
    #binding-cells = <2>;
    flavor = "hold-preferred";
    tapping-term-ms = <200>;
    quick-tap-ms = <175>;
    bindings = <&sl_long>, <&arcane_left>;
};

arcane_nav_r: arcane_nav_r {
    compatible = "zmk,behavior-hold-tap";
    #binding-cells = <2>;
    flavor = "hold-preferred";
    tapping-term-ms = <200>;
    quick-tap-ms = <175>;
    bindings = <&sl_long>, <&arcane_right>;
};


	// hold LGUI, tap for space, double tap for tab
	// BUT using this may make spaces slooow so we'll switch to something else soon
        lgui_space_tab: lgui_space_tab {
            compatible = "zmk,behavior-tap-dance";
            #binding-cells = <0>;
            tapping-term-ms = <FAST_TAP>;
            bindings = <&ht_mod_kp LGUI SPACE>, <&kp TAB>;
        };

	// hold RGUI, tap for space, double tap for return
	// BUT using this may make spaces slooow so we'll switch to something else soon
        rgui_space_ret: rgui_space_ret {
            compatible = "zmk,behavior-tap-dance";
            #binding-cells = <0>;
            tapping-term-ms = <FAST_TAP>;
            bindings = <&ht_mod_kp RGUI SPACE>, <&kp RET>;
        };

	// outer right thumb: tap = sticky NUMERIC, double tap = smart NUMPAD
        sl_num_or_word: sl_num_or_word {
            compatible = "zmk,behavior-tap-dance";
            #binding-cells = <0>;
            tapping-term-ms = <FAST_TAP>;
            bindings = <&sl_long NUMERIC>, <&numpad_word NUMPAD>;
        };

	// outer left thumb: tap = sticky SYMBOL, double tap = smart NUMPAD
        sl_sym_or_numpad: sl_sym_or_numpad {
            compatible = "zmk,behavior-tap-dance";
            #binding-cells = <0>;
            tapping-term-ms = <FAST_TAP>;
            bindings = <&sl_long SYMBOL>, <&numpad_word NUMPAD>;
        };

        LTS: LTS {
            compatible = "zmk,behavior-hold-tap";
            #binding-cells = <2>;
            tapping-term-ms = <200>;
            quick-tap-ms = <175>;
            require-prior-idle-ms = <HRM_PRIOR_IDLE>;
            flavor = "balanced";
            bindings = <&mo>, <&kp>;
        };

    };


    /* incomplete definition but should have basics for changing underglow while momentarily in a layer.
   ideally would save/restore preexisting underglow color.
   
    mo_rgb: mo_rgb {
        wait-ms = <0>;
 	tap-ms = <0>;
	bindings
	    = <&macro_press &mo 1>
	        , <&macro_tap &rgb_ug RGB_COLOR_HSB(128,100,100)>
		, <&macro_pause_for_release>
		, <&macro_release &mo 1>
		, <&macro_tap &rgb_ug RGB_COLOR_HSB(300,100,50)>
	;
    ;

*/

    /* Using tap_hold_layer_lgui directly in the keymap instead of a custom f_key behavior */

    /*
     * The lighting layer's encoder. On a board with rgbzone this drives its
     * global brightness; elsewhere it still drives ZMK's underglow, which is
     * what the other boards have.
     */
    lighting_encoder: lighting_encoder {
        compatible = "zmk,behavior-sensor-rotate";
        #sensor-binding-cells = <0>;
#ifdef RGBZONE_PRESENT
        bindings = <&rgbz_up>, <&rgbz_dn>;
#else
        bindings = <&rgb_ug RGB_BRI>, <&rgb_ug RGB_BRD>;
#endif
    };

    scroll_encoder: scroll_encoder {
        compatible = "zmk,behavior-sensor-rotate";
        #sensor-binding-cells = <0>;
        bindings = <&msc SCRL_DOWN>, <&msc SCRL_UP>;
        tap-ms = <30>;
    };


// ****************************************** QWERTY layer

#define QWERTY_LZ &trans &trans &trans &trans &trans &trans
#define QWERTY_LT_IN &kp Q  &kp W  &kp E  &kp R  &kp T
#define QWERTY_LT &kp TAB  QWERTY_LT_IN
#define QWERTY_LM_IN &tap_hold_layer_lgui LGUI_NAV_L A  &hml L_M3 S  &hml L_M2 D  &hml L_M1 F  &kp G
#define QWERTY_LM &key_layer_SQT_NUM  QWERTY_LM_IN
#define QWERTY_LB_IN &kp Z  &kp X  &kp C  &kp V  &kp B
#define QWERTY_LB &trans  QWERTY_LB_IN
#define QWERTY_LH &LTS EXTRA ESC  &smart_nav_thumb NAV TAB  &lgui_space_tab
#define QWERTY_LH_5 &trans &trans QWERTY_LH


#define QWERTY_RZ &trans &trans &trans &trans &trans &trans
#define QWERTY_RT_IN &kp Y  &kp U  &kp I  &kp O  &kp P
#define QWERTY_RT QWERTY_RT_IN  &backspace_word_delete
#define QWERTY_RM_IN &kp H  &hmr R_M1 J  &hmr R_M2 K  &hmr R_M3 L  &tap_hold_layer_rgui RGUI_NAV_R SEMI
#define QWERTY_RM QWERTY_RM_IN  &key_layer_DQT_NUM
#define QWERTY_RB_IN &kp N  &kp M  &kp COMMA  &kp DOT  &kp FSLH
#define QWERTY_RB QWERTY_RB_IN  &kp RET
#define QWERTY_RH &rgui_space_ret  &smart_nav_thumb NAV BSPC  &LTS FN RETURN
#define QWERTY_RH_5 &trans &trans QWERTY_RH


// ****************************************** GAMING layer

#define GAMING_LZ &trans &trans &trans &trans &trans &trans
// ESC and CAPS are combos here (see combos.dtsi), which buys back the two outer
// keys they were sitting on. TAB takes the top one.
//
// The pinky gets a third way to the digits, alongside both thumbs. Three is one
// too many on purpose: which reach turns out to be natural under pressure is
// not something to decide at a desk, and the losers cost nothing until they are
// dropped.
#define GAMING_LT_IN &kp Q  &kp W  &kp E  &kp R  &kp T
#define GAMING_LT &kp TAB  GAMING_LT_IN
#define GAMING_LM_IN &kp A  &kp S  &kp D  &kp F  &kp G
#define GAMING_LM &sl NUMPAD  GAMING_LM_IN
#define GAMING_LB_IN &kp Z  &kp X  &kp C  &kp V  &kp B
#define GAMING_LB &kp LSHIFT  GAMING_LB_IN
// Nothing on these thumbs may be a hold-tap. A game holds crouch, holds jump,
// holds the scoreboard -- every one of those is a hold that means itself, and
// a hold-tap reads it as the other thing. Space in particular was an HRM: hold
// it to jetpack or swim and you got LALT.
//
// TAB moved to the top-left key, which frees the middle thumb for digits.
// Sticky rather than momentary: a held layer is one more thing to keep held
// while moving, and &sl wants only a tap. Plain &sl, not sl_long -- five
// seconds is right for prose and wrong here, where a stray press should expire
// before it eats a movement key.
#define GAMING_LH &kp LCTRL  &sl NUMPAD  &kp SPACE
#define GAMING_LH_5 &trans &trans GAMING_LH

#define GAMING_RZ &trans &trans &trans &trans &trans &trans
#define GAMING_RT_IN &kp Y  &kp U  &kp I  &kp O  &kp P
#define GAMING_RT GAMING_RT_IN  &kp BSPC
#define GAMING_RM_IN &kp H  &kp J  &kp K  &kp L  &kp SEMI
#define GAMING_RM GAMING_RM_IN  &kp SQT
#define GAMING_RB_IN &kp N  &kp M  &kp COMMA  &kp DOT  &kp FSLH
#define GAMING_RB GAMING_RB_IN  &kp RSHIFT
// The right hand is on the mouse, so these three are nearly dead. RETURN earns
// its place for chat; the other two are a second space and a backspace nobody
// reaches for, and both were hold-taps besides. Left as a second digit key and
// a spare, in reach if the hand comes back to the board.
#define GAMING_RH &sl NUMPAD  &none  &kp RETURN
#define GAMING_RH_5 &trans &trans GAMING_RH

// ******************************************  hierophant (alt_alpha) layer

// defined in hierophant.dtsi

// ****************************************** CAPS layer

// Placeholder layer, entirely transparent. Nothing activates it; it exists so
// the layers numbered after it keep their indices.
#define EMPTY_2_LZ &trans &trans &trans &trans &trans &trans
#define EMPTY_2_LT_IN &trans  &trans  &trans  &trans  &trans
#define EMPTY_2_LT &trans  EMPTY_2_LT_IN
#define EMPTY_2_LM_IN &trans  &trans  &trans  &trans  &trans
#define EMPTY_2_LM &trans  EMPTY_2_LM_IN
#define EMPTY_2_LB_IN &trans  &trans  &trans  &trans  &trans
#define EMPTY_2_LB &trans  EMPTY_2_LB_IN
#define EMPTY_2_LH &trans &trans &trans
#define EMPTY_2_LH_5 &trans &trans EMPTY_2_LH

#define EMPTY_2_RZ &trans &trans &trans &trans &trans &trans
#define EMPTY_2_RT_IN &trans  &trans  &trans  &trans  &trans
#define EMPTY_2_RT EMPTY_2_RT_IN  &trans
#define EMPTY_2_RM_IN &trans  &trans  &trans  &trans  &trans
#define EMPTY_2_RM EMPTY_2_RM_IN  &trans
#define EMPTY_2_RB_IN &trans  &trans  &trans  &trans  &trans
#define EMPTY_2_RB EMPTY_2_RB_IN  &trans
#define EMPTY_2_RH &trans &trans &trans
#define EMPTY_2_RH_5 &trans &trans EMPTY_2_RH


// ******************************************  NUMERIC layer

#define NUMERIC_LZ &trans     &trans        &trans        &trans        &trans        &trans
#define NUMERIC_LT_IN &kp EXCL  &kp AT  &kp HASH  &kp DOLLAR  &kp PERCENT
#define NUMERIC_LT &kp GRAVE  NUMERIC_LT_IN
#define NUMERIC_LM_IN &hml L_M4 N1  &hml L_M3 N2  &hml L_M2 N3  &hml L_M1 N4  &kp N5
#define NUMERIC_LM &kp N0  NUMERIC_LM_IN
#define NUMERIC_LB_IN &trans  &trans  &trans  &trans  &cancel
#define NUMERIC_LB &trans  NUMERIC_LB_IN
#define NUMERIC_LH &trans  &trans  &trans
#define NUMERIC_LH_5 &trans &trans NUMERIC_LH


#define NUMERIC_RZ &trans     &trans        &trans        &trans        &trans        &trans
#define NUMERIC_RT_IN &kp CARET  &kp AMPS  &kp ASTERISK  &kp LPAR  &kp RPAR
#define NUMERIC_RT NUMERIC_RT_IN  &kp EQUAL
#define NUMERIC_RM_IN &kp N6  &hmr R_M1 N7  &hmr R_M2 N8  &hmr R_M3 N9  &hmr R_M4 N0
#define NUMERIC_RM NUMERIC_RM_IN  &kp MINUS
#define NUMERIC_RB_IN &cancel  &trans  &trans  &trans  &trans
#define NUMERIC_RB NUMERIC_RB_IN  &trans
#define NUMERIC_RH &trans  &kp BACKSPACE  &kp PERIOD
#define NUMERIC_RH_5 &trans &trans NUMERIC_RH



// ******************************************  NAVIGATION layer

#define NAVIGATION_LZ &trans &trans &trans &trans &trans &trans
#define NAVIGATION_LT_IN &kp PG_UP  &kp END  &kp UP_ARROW  &kp HOME  &msc_up_variable
#define NAVIGATION_LT &trans  NAVIGATION_LT_IN
#define NAVIGATION_LM_IN &hml L_M4 PG_DN  &hml L_M3 LEFT_ARROW  &hml L_M2 DOWN_ARROW  &hml L_M1 RIGHT_ARROW  &msc_down_variable
#define NAVIGATION_LM &trans  NAVIGATION_LM_IN
#define NAVIGATION_LB_IN &trans  &trans  &trans  &trans  &trans
#define NAVIGATION_LB &trans  NAVIGATION_LB_IN
#define NAVIGATION_LH &trans  &trans  &kp SPACE                                                          
#define NAVIGATION_LH_5 &trans &trans NAVIGATION_LH

#define NAVIGATION_RZ &trans &trans &trans &trans &trans &trans
#define NAVIGATION_RT_IN &msc_up_variable  &kp HOME  &kp UP_ARROW  &kp END  &kp PG_UP
#define NAVIGATION_RT NAVIGATION_RT_IN  &trans
#define NAVIGATION_RM_IN &msc_down_variable  &hmr R_M1 LEFT_ARROW  &hmr R_M2 DOWN_ARROW  &hmr R_M3 RIGHT_ARROW  &hmr R_M4 PG_DN
#define NAVIGATION_RM NAVIGATION_RM_IN  &trans
#define NAVIGATION_RB_IN &mkp MB2  &mkp MB3  &mkp MB4  &mkp MB5  &trans
#define NAVIGATION_RB NAVIGATION_RB_IN  &trans
#define NAVIGATION_RH &kp SPACE  &trans  &trans
#define NAVIGATION_RH_5 &trans &trans NAVIGATION_RH



// ******************************************  FUNCTION layer

MAKE_ADAPTIVE_REPEAT(f_hrk_f14, hml, L_M4, F14)
MAKE_ADAPTIVE_REPEAT(f_hrk_f15, hml, L_M3, F15)
MAKE_ADAPTIVE_REPEAT(f_hrk_f16, hml, L_M2, F16)
MAKE_ADAPTIVE_REPEAT(f_hrk_f17, hml, L_M1, F17)

MAKE_ADAPTIVE_REPEAT(f_hrk_f20, hmr, R_M1, F20)
MAKE_ADAPTIVE_REPEAT(f_hrk_f21, hmr, R_M2, F21)
MAKE_ADAPTIVE_REPEAT(f_hrk_f22, hmr, R_M3, F22)
MAKE_ADAPTIVE_REPEAT(f_hrk_f23, hmr, R_M4, F23)


#define FUNCTION_LZ &trans   &trans      &trans      &trans       &trans      &trans
#define FUNCTION_LT_IN &kp F2  &kp F3  &kp F4  &kp F5  &kp F6
#define FUNCTION_LT &kp F1  FUNCTION_LT_IN
#define FUNCTION_LM_IN &f_hrk_f14  &f_hrk_f15  &f_hrk_f16  &f_hrk_f17  &kp F18
#define FUNCTION_LM &kp F13  FUNCTION_LM_IN
// &sys_reset and &bootloader used to live here, under "," and "K". They moved
// to SYSTEM, which is reached only by a leader sequence -- a layer that can
// reboot the keyboard should not sit one keypress from the alphabet.
#define FUNCTION_LB_IN &trans  &trans  &trans  &trans  &mkp MB5
#define FUNCTION_LB &trans  FUNCTION_LB_IN
#define FUNCTION_LH &trans &trans &build_time
#define FUNCTION_LH_5 &trans &trans FUNCTION_LH


#define FUNCTION_RZ &trans &trans &trans &trans &trans &trans
#define FUNCTION_RT_IN &kp F7  &kp F8  &kp F9  &kp F10  &kp F11
#define FUNCTION_RT FUNCTION_RT_IN  &kp F12
#define FUNCTION_RM_IN &kp F19  &f_hrk_f20  &f_hrk_f21  &f_hrk_f22  &f_hrk_f23
#define FUNCTION_RM FUNCTION_RM_IN  &kp F24
#define FUNCTION_RB_IN &trans  &trans  &trans  &trans  &kp SCROLLLOCK
#define FUNCTION_RB FUNCTION_RB_IN  &kp PAUSE_BREAK
#define FUNCTION_RH &build_time  &trans  &trans
#define FUNCTION_RH_5 &trans &trans FUNCTION_RH

// ******************************************  EXTRA layer

#define EXTRA_LZ &trans        &trans    &trans    &trans    &trans    &trans
#define EXTRA_LT_IN &trans  &kp MENU  &trans  &trans  &kp DELETE
#define EXTRA_LT &smart_w  EXTRA_LT_IN
#define EXTRA_LM_IN &sk_long L_M4  &sk_long L_M3  &sk_long L_M2  &sk_long L_M1  &trans
#define EXTRA_LM &trans  EXTRA_LM_IN
#define EXTRA_LB_IN &trans  &trans  &trans  &trans  &trans
#define EXTRA_LB &dash_emdash  EXTRA_LB_IN
#define EXTRA_LH                      &trans &oneshot_or_to_NAVIGATION &trans
#define EXTRA_LH_5 &trans &trans EXTRA_LH


#define EXTRA_RZ &trans      &trans        &trans    &trans           &trans      &trans
#define EXTRA_RT_IN &kp INSERT  &at_wgyl_org  &trans  &leader  &phone_alt
#define EXTRA_RT EXTRA_RT_IN  &trans
#define EXTRA_RM_IN &trans  &sk_long R_M1  &sk_long R_M2  &sk_long R_M3  &sk_long R_M4
#define EXTRA_RM EXTRA_RM_IN  &trans
#define EXTRA_RB_IN &trans  &trans  &trans  &personal_email  &trans
#define EXTRA_RB EXTRA_RB_IN  &key_repeat
#define EXTRA_RH   		  &trans &oneshot_or_to_NAVIGATION &trans
#define EXTRA_RH_5 &trans &trans EXTRA_RH


// ******************************************  LIGHTING layer
//
// Was the RGB layer, back when the lighting ran ZMK's underglow effects.
// rgbzone paints columns by what they do, so hue, saturation, effect and speed
// have nothing left to act on -- what remains worth reaching is whether the
// lights are on at all and how bright. Reached with leader L E D.
//
// On a board without rgbzone the keys go transparent rather than vanish, so
// the shared row macros stay usable there.

#ifdef RGBZONE_PRESENT
  #define LIGHT_TOG &rgbz_tog
  #define LIGHT_UP  &rgbz_up
  #define LIGHT_DN  &rgbz_dn
#else
  #define LIGHT_TOG &trans
  #define LIGHT_UP  &trans
  #define LIGHT_DN  &trans
#endif

#define LIGHTING_LZ &trans &trans &trans &trans &trans &trans
#define LIGHTING_RZ &trans &trans &trans &trans &trans &trans

// Toggle and brightness keep the keys the old on/off and brighter/dimmer had.
//                        on/off
#define LIGHTING_LT_IN LIGHT_TOG  &trans  &trans  &trans  &trans
#define LIGHTING_LT &trans  LIGHTING_LT_IN
#define LIGHTING_RT_IN &trans  &trans  &trans  &trans  &trans
#define LIGHTING_RT LIGHTING_RT_IN  &trans

//                        brighter   dimmer
#define LIGHTING_LM_IN LIGHT_UP  LIGHT_DN  &trans  &trans  &trans
#define LIGHTING_LM &trans  LIGHTING_LM_IN
#define LIGHTING_RM_IN &trans  &trans  &trans  &trans  &trans
#define LIGHTING_RM LIGHTING_RM_IN  &trans

#define LIGHTING_LB_IN &trans  &trans  &trans  &trans  &trans
#define LIGHTING_LB &trans  LIGHTING_LB_IN
#define LIGHTING_RB_IN &trans  &trans  &trans  &trans  &trans
#define LIGHTING_RB LIGHTING_RB_IN  &trans

// The layer is otherwise transparent, so without these there is no way back.
#define LIGHTING_LH &trans &trans &to HIEROPHANT
#define LIGHTING_RH &to HIEROPHANT &trans &trans 

#define LIGHTING_LH_5 &trans &trans LIGHTING_LH
#define LIGHTING_RH_5 &trans &trans LIGHTING_RH



// ******************************************  SYSTEM layer

#define SYSTEM_LZ &trans &trans &trans &trans &trans &trans

#define SYSTEM_LT_IN &trans  &trans  &trans  &trans  &trans
#define SYSTEM_LT &trans  SYSTEM_LT_IN

#define SYSTEM_LM_IN &trans  &trans  &trans  &trans  &trans
#define SYSTEM_LM &trans  SYSTEM_LM_IN
//#define SYSTEM_LM &bt BT_SEL 0  &hml L_M4 &bt BT_SEL 1  &hml L_M3 &bt BT_SEL 2  &hml L_M2 &bt BT_SEL 3  &hml L_M1 &bt BT_SEL 4 &bt BT_SEL 5


// SYSTEM carries the two keys that must not be reachable by accident, and
// nothing else: it is leader-only, so nothing here can be hit by a stray press.
// Bluetooth lives on BLUETOOTH and brightness on LIGHTING; a key with a home
// elsewhere does not want a second one here.
//
// Reset and bootloader sit on mirrored positions -- LB1/RB4 and LB3/RB2 are the
// same finger on each hand -- so which half you are reaching for is the only
// thing you have to think about, and it is the same reach either way.
#define SYSTEM_LB_IN &sys_reset  &trans  &bootloader  &trans  &trans
#define SYSTEM_LB &trans  SYSTEM_LB_IN
#define SYSTEM_LH &trans &trans &to HIEROPHANT
#define SYSTEM_LH_5 &trans &trans SYSTEM_LH

#define SYSTEM_RZ &trans &trans &trans &trans &trans &trans
#define SYSTEM_RT_IN &trans  &trans  &trans  &trans  &trans
#define SYSTEM_RT SYSTEM_RT_IN  &trans
#define SYSTEM_RM_IN &trans  &trans  &trans  &trans  &trans
#define SYSTEM_RM SYSTEM_RM_IN  &trans
#define SYSTEM_RB_IN &trans  &trans  &bootloader  &trans  &sys_reset
#define SYSTEM_RB SYSTEM_RB_IN  &trans
#define SYSTEM_RH &to HIEROPHANT &trans &trans
#define SYSTEM_RH_5 &trans &trans SYSTEM_RH


// ******************************************  LGUI+NAV layer

// NOTE that this currently requires manual maintenance when the keys of the default layer change.
// ideally, there would be an elegant way to bind a key to "&trans + modifier"

#define LGN_LZ &trans &trans &trans &trans &trans &trans
#define LGN_LT_IN &kp LG(F)  &kp LG(Z)  &kp LG(U)  &kp LG(Q)  &kp LG(BSPC)
#define LGN_LT &kp LG(TAB)  LGN_LT_IN
#define LGN_LM_IN &trans  &hml L_M3 LG(I)  &hml L_M2 LG(E)  &hml L_M1(A)  &kp LG(P)
#define LGN_LM &trans  LGN_LM_IN
#define LGN_LB_IN &kp LG(COMMA)  &kp LG(Y)  &kp LG(K)  &kp LG(O)  &kp LG(X)
#define LGN_LB &kp LG(BSLH)  LGN_LB_IN
#define LGN_LH &kp LG(ESC)  &kp LG(TAB)  &to HIEROPHANT
#define LGN_LH_5 &trans &trans LGN_LH


#define LGN_RZ &trans &trans &trans &trans &trans &trans
#define LGN_RT_IN &msc LG(SCRL_UP)  &kp LG(HOME)  &kp LG(UP_ARROW)  &kp LG(END)  &kp LG(PG_UP)
#define LGN_RT LGN_RT_IN  &kp LG(BSPC)
#define LGN_RM_IN &msc LG(SCRL_DOWN)  &kp LG(LEFT_ARROW)  &kp LG(DOWN_ARROW)  &kp LG(RIGHT_ARROW)  &kp LG(PG_DN)
#define LGN_RM LGN_RM_IN  &kp LG(SQT)
#define LGN_RB_IN &kp LG(V)  &kp LG(C)  &kp LG(M)  &kp LG(J)  &kp LG(DOT)
#define LGN_RB LGN_RB_IN  &kp LG(FSLH)
#define LGN_RH &to HIEROPHANT &numpad_word NUMPAD  &kp LG(RET)
#define LGN_RH_5 &trans &trans LGN_RH


// ******************************************  RGUI+NAV layer

// NOTE that this currently requires manual maintenance when the keys of the default layer change.
// ideally, there would be an elegant way to bind a key to "&trans + modifier"

#define RGN_LZ &trans &trans &trans &trans &trans &trans
#define RGN_LT_IN &kp RG(PG_UP)  &kp RG(DELETE)  &kp RG(UP_ARROW)  &kp RG(HOME)  &msc RG(SCRL_UP)
#define RGN_LT &kp RG(TAB)  RGN_LT_IN
#define RGN_LM_IN &kp RG(PG_DN)  &kp RG(LEFT_ARROW)  &kp RG(DOWN_ARROW)  &kp RG(RIGHT_ARROW)  &msc RG(SCRL_DOWN)
#define RGN_LM &trans  RGN_LM_IN
#define RGN_LB_IN &kp RG(COMMA)  &kp RG(Y)  &kp RG(K)  &kp RG(O)  &kp RG(X)
#define RGN_LB &kp RG(BSLH)  RGN_LB_IN
#define RGN_LH &kp RG(ESC)   &symbol_word SYMBOL   &to HIEROPHANT
#define RGN_LH_5 &trans &trans RGN_LH


#define RGN_RZ &trans &trans &trans &trans &trans &trans
#define RGN_RT_IN &kp RG(RETURN)  &kp RG(W)  &kp RG(D)  &kp RG(L)  &kp RG(B)
#define RGN_RT RGN_RT_IN  &kp RG(BSPC)
#define RGN_RM_IN &kp RG(G)  &hmr R_M1(S)  &hmr R_M2 RG(T)  &hmr R_M3 RG(R)  &trans
#define RGN_RM RGN_RM_IN  &kp RG(SQT)
#define RGN_RB_IN &kp RG(V)  &kp RG(C)  &kp RG(M)  &kp RG(J)  &kp RG(DOT)
#define RGN_RB RGN_RB_IN  &kp RG(FSLH)
#define RGN_RH &to HIEROPHANT  &kp RG(BSPC)  &kp RG(RET)
#define RGN_RH_5 &trans &trans RGN_RH


// ******************************************  BLUETOOTH layer


		
#define BLUETOOTH_LZ &trans &trans &trans &trans &trans &trans
// ZMK_BLE_PROFILE_COUNT = BT_MAX_PAIRED(6) - SPLIT_PERIPHERALS(1) = 5, so the
// valid profiles are 0-4 and the old `BT_SEL 5` here was a dead key. Raising
// CONFIG_BT_MAX_PAIRED to 7 would give a sixth, at the cost of re-pairing.
#ifdef CONFIG_WIRELESS
#define BLUETOOTH_LT_IN &bt BT_SEL 1  &bt BT_SEL 2  &bt BT_SEL 3  &bt BT_SEL 4  &bt BT_SEL 5
#define BLUETOOTH_LT &bt BT_SEL 0  BLUETOOTH_LT_IN
#define BLUETOOTH_LM_IN &bt BT_DISC 1  &bt BT_DISC 2  &bt BT_DISC 3  &bt BT_DISC 4  &bt BT_DISC 5
#define BLUETOOTH_LM &bt BT_DISC 0  BLUETOOTH_LM_IN
#define BLUETOOTH_LB_IN &trans  &trans  &trans  &trans  &trans
#define BLUETOOTH_LB &bt BT_CLR  BLUETOOTH_LB_IN
#else
// On a wired-only board this whole layer is a placeholder. It stays in the
// keymap so that LIGHTING=13 / BLUETOOTH=14 / SYSTEM=15 mean the same thing on
// every keyboard sharing this layout.
#define BLUETOOTH_LT_IN &none  &none  &none  &none  &trans
#define BLUETOOTH_LT &none  BLUETOOTH_LT_IN
#define BLUETOOTH_LM_IN &none  &none  &none  &none  &none
#define BLUETOOTH_LM &none  BLUETOOTH_LM_IN
#define BLUETOOTH_LB_IN &trans  &trans  &trans  &trans  &trans
#define BLUETOOTH_LB &none  BLUETOOTH_LB_IN
#endif
#define BLUETOOTH_LH &trans &trans &to HIEROPHANT
#define BLUETOOTH_LH_5 &trans &trans BLUETOOTH_LH

#define BLUETOOTH_RZ &trans &trans &trans &trans &trans &trans
// Output routing. Without these there is no way to force USB or BLE: with both
// connected ZMK picks USB, and nothing in this config could override that.
//                       force USB      force BLE      toggle
#ifdef CONFIG_WIRELESS
#define BLUETOOTH_RT_IN &out OUT_USB  &out OUT_BLE  &out OUT_TOG  &trans  &trans
#else
// USB is the only endpoint there is, so there is nothing to route.
#define BLUETOOTH_RT_IN &none  &none  &none  &trans  &trans
#endif
#define BLUETOOTH_RT BLUETOOTH_RT_IN  &trans
#define BLUETOOTH_RM_IN &trans  &trans  &trans  &trans  &trans
#define BLUETOOTH_RM BLUETOOTH_RM_IN  &trans
// Clear-all mirrors clear-this-one on the far pinky: the same shape of act, as
// far from each other as the board allows.
#define BLUETOOTH_RB_IN &trans  &trans  &trans  &trans  &trans
#ifdef CONFIG_WIRELESS
#define BLUETOOTH_RB BLUETOOTH_RB_IN  &bt BT_CLR_ALL
#else
// &bt does not exist without ZMK_BLE, and an unguarded one is not a dead key on
// a wired-only board -- it is an unresolvable phandle that fails the build.
#define BLUETOOTH_RB BLUETOOTH_RB_IN  &none
#endif
#define BLUETOOTH_RH &to HIEROPHANT &trans &trans
#define BLUETOOTH_RH_5 &trans &trans BLUETOOTH_RH


		
// ****************************************** SUPERSCRIPT layer
//
// Each letter position emits the Unicode superscript of the letter that sits
// there on the hierophant base layer. Everything else -- backspace, enter,
// mods, punctuation, the thumbs -- stays &trans so it keeps working while the
// layer is on; without that the layer would be a trap.
//
// Enter with LEADER S U P E R (leader.dtsi), leave with either inner thumb,
// matching how the LGN/RGN layers exit.
//
// NOTE: the original design in alphanumerics.dtsi took a different route --
// per-letter "smart_*" morphs behind #ifdef SUPERSCRIPT_REALLY, emitting the
// superscript only while this layer was active. That depends on
// zmk,behavior-layer-morph-fixed, which does not exist in ZMK or in any module
// here, so it could never have compiled. Doing it as a plain layer needs no
// new behaviour.
//
// q is deliberately &trans: Unicode has no superscript q in the modifier-letter
// block that the rest of these come from, so it falls through and types a
// normal q rather than emitting something no font will render.

#define SUP_A &uc 0x1D43 0     // ᵃ
#define SUP_B &uc 0x1D47 0     // ᵇ
#define SUP_C &uc 0x1D9C 0     // ᶜ
#define SUP_D &uc 0x1D48 0     // ᵈ
#define SUP_E &uc 0x1D49 0     // ᵉ
#define SUP_F &uc 0x1DA0 0     // ᶠ
#define SUP_G &uc 0x1D4D 0     // ᵍ
#define SUP_H &uc 0x02B0 0     // ʰ
#define SUP_I &uc 0x2071 0     // ⁱ
#define SUP_J &uc 0x02B2 0     // ʲ
#define SUP_K &uc 0x1D4F 0     // ᵏ
#define SUP_L &uc 0x02E1 0     // ˡ
#define SUP_M &uc 0x1D50 0     // ᵐ
#define SUP_N &uc 0x207F 0     // ⁿ
#define SUP_O &uc 0x1D52 0     // ᵒ
#define SUP_P &uc 0x1D56 0     // ᵖ
#define SUP_R &uc 0x02B3 0     // ʳ
#define SUP_S &uc 0x02E2 0     // ˢ
#define SUP_T &uc 0x1D57 0     // ᵗ
#define SUP_U &uc 0x1D58 0     // ᵘ
#define SUP_V &uc 0x1D5B 0     // ᵛ
#define SUP_W &uc 0x02B7 0     // ʷ
#define SUP_X &uc 0x02E3 0     // ˣ
#define SUP_Y &uc 0x02B8 0     // ʸ
#define SUP_Z &uc 0x1DBB 0     // ᶻ

#define SUPERSCRIPT_LZ &trans &trans &trans &trans &trans &trans
#define SUPERSCRIPT_RZ &trans &trans &trans &trans &trans &trans

//                         f      z      u      q(none)  bspc
#define SUPERSCRIPT_LT_IN SUP_F  SUP_Z  SUP_U  &trans   &trans
#define SUPERSCRIPT_LT &trans  SUPERSCRIPT_LT_IN
//                         w      d      l      b
#define SUPERSCRIPT_RT_IN &trans  SUP_W  SUP_D  SUP_L  SUP_B
#define SUPERSCRIPT_RT SUPERSCRIPT_RT_IN  &trans

// Home row keeps its mods, mirroring hierophant: h=LGUI i=LALT e=LSHIFT a=LCTRL.
#define SUPERSCRIPT_LM_IN &hml_sup L_M4 0x02B0  &hml_sup L_M3 0x2071  &hml_sup L_M2 0x1D49  &hml_sup L_M1 0x1D43  SUP_P
#define SUPERSCRIPT_LM &trans  SUPERSCRIPT_LM_IN
// Mirrored on the right: s=RCTRL t=RSHIFT r=RALT n=RGUI.
#define SUPERSCRIPT_RM_IN SUP_G  &hmr_sup R_M1 0x02E2  &hmr_sup R_M2 0x1D57  &hmr_sup R_M3 0x02B3  &hmr_sup R_M4 0x207F
#define SUPERSCRIPT_RM SUPERSCRIPT_RM_IN  &trans

//                         ,      y      k      o      x
#define SUPERSCRIPT_LB_IN &trans  SUP_Y  SUP_K  SUP_O  SUP_X
#define SUPERSCRIPT_LB &trans  SUPERSCRIPT_LB_IN
//                         v      c      m      j      .
#define SUPERSCRIPT_RB_IN SUP_V  SUP_C  SUP_M  SUP_J  &trans
#define SUPERSCRIPT_RB SUPERSCRIPT_RB_IN  &trans

// Inner thumbs leave the layer, as in LGN/RGN.
#define SUPERSCRIPT_LH &trans &trans &to HIEROPHANT
#define SUPERSCRIPT_RH &to HIEROPHANT &trans &trans

#define SUPERSCRIPT_LH_5 &trans &trans SUPERSCRIPT_LH
#define SUPERSCRIPT_RH_5 &trans &trans SUPERSCRIPT_RH


// ******************************************  NUMPAD layer

#define NUMPAD_LZ &trans &trans &trans &trans &trans &trans
// Top row carries the layer keys, on the same fingers as hierophant:
// pinky=FUNCTION ring=EXTRA middle=SYMBOL. The index finger's hierophant key is
// NUMPAD itself, which is pointless from here, so it stays a plain digit.
//
// Inner index: `*`, where `?` was. STAR is LS(N8), so ignore-numbers keeps
// word mode alive across it without a continue-list entry.
#define NUMPAD_LT_IN &pad_tll_sticky FN N0  &pad_tll_sticky EXTRA N1  &pad_tll SYMBOL N2  &kp N3  &kp STAR
#define NUMPAD_LT &kp BSLH  NUMPAD_LT_IN
// Home row keeps its mods, mirroring hierophant: pinky=LGUI ring=LALT
// middle=LSHIFT index=LCTRL. Taps are unchanged, so a number typed here is
// still a number and numpad_word's ignore-numbers keeps the layer alive.
// Holding one presses a modifier, and a modifier keycode is not in the
// continue-list -- so the layer drops on the spot and whatever the other hand
// presses next comes from hierophant. Ctrl+Z during numeric entry is Z, not 7.
// Comma on the inner index of both hands, on the home row -- the strongest
// free position, and where a thousands separator wants to be.
//
// It canNOT go where `<` and `>` live: those are LS(COMMA) and LS(DOT), with
// the shift baked into the binding by ZMK, which is the only kind of shift this
// layer can express. A user-held shift drops NUMPAD before the next key
// resolves (that is the whole point of the home-row mods here), so anything
// reached by holding shift is unreachable from this layer. Swapping `<` for a
// plain COMMA therefore does not keep `<` "under shift" -- it deletes it.
//
// The cost is `'` and `"`, which had this slot. Comma is worth more here.
#define NUMPAD_LM_IN &hml_pad L_M4 PLUS  &hml_pad L_M3 N4  &hml_pad L_M2 N5  &hml_pad L_M1 N6  &kp COMMA
#define NUMPAD_LM &trans  NUMPAD_LM_IN
#define NUMPAD_LB_IN &kp DOT  &kp N7  &kp N8  &kp N9  &kp LESS_THAN
#define NUMPAD_LB &trans  NUMPAD_LB_IN
// Thumbs, outer to inner: 0, then `.` (tap) / NAV (hold), then the inner thumb
// falls through to hierophant's space. Space and enter are not in the
// continue-list, so they finish the number and leave NUMPAD -- which is right.
#define NUMPAD_LH &kp N0  &pad_nav NAV DOT  &trans
#define NUMPAD_LH_5 &trans &trans NUMPAD_LH


#define NUMPAD_RZ &trans   &trans &trans &trans  &trans     &trans
// Mirrored: middle=SYMBOL ring=EXTRA pinky=FUNCTION.
//
// The inner-index 0 is jjb's zero, in use -- NOT a spare duplicate of the
// outer thumb's. Do not repurpose it.
#define NUMPAD_RT_IN &kp N0  &kp N1  &pad_tlr SYMBOL N2  &pad_tlr_sticky EXTRA N3  &pad_tlr_sticky FN MINUS
#define NUMPAD_RT NUMPAD_RT_IN  &kp FSLH
// Mirrored on the right: index=RCTRL middle=RSHIFT ring=RALT pinky=RGUI.
#define NUMPAD_RM_IN &kp COMMA  &hmr_pad R_M1 N4  &hmr_pad R_M2 N5  &hmr_pad R_M3 N6  &hmr_pad R_M4 PLUS
#define NUMPAD_RM NUMPAD_RM_IN  &trans
#define NUMPAD_RB_IN &kp GREATER_THAN  &kp N7  &kp N8  &kp N9  &kp DOT
#define NUMPAD_RB NUMPAD_RB_IN  &trans
// Inner to outer: hierophant's space/enter, then backspace (tap) / NAV (hold),
// then 0. Backspace was in numpad_word's continue-list but on no key of this
// layer; this is the slot NUMERIC already gives it (NUMERIC_RH).
#define NUMPAD_RH &trans  &pad_nav NAV BSPC  &kp N0
#define NUMPAD_RH_5 &trans &trans NUMPAD_RH




// ****************************************** SYMBOL layer

#include "symbol.dtsi"



/*

// ******************************************  EMPTY layer

#define _LZ &trans &trans &trans &trans &trans &trans
#define _LT_IN &trans  &trans  &trans  &trans  &trans
#define _LT &trans  _LT_IN
#define _LM_IN &trans  &trans  &trans  &trans  &trans
#define _LM &trans  _LM_IN
#define _LB_IN &trans  &trans  &trans  &trans  &trans
#define _LB &trans  _LB_IN
#define _LH &trans &trans &trans
#define _LH_5 &trans &trans _LH


#define _RZ &trans &trans &trans &trans &trans &trans
#define _RT_IN &trans  &trans  &trans  &trans  &trans
#define _RT _RT_IN  &trans
#define _RM_IN &trans  &trans  &trans  &trans  &trans
#define _RM _RM_IN  &trans
#define _RB_IN &trans  &trans  &trans  &trans  &trans
#define _RB _RB_IN  &trans
#define _RH &trans &trans &trans
#define _RH_5 &trans &trans _RH

*/

		
}; // root node

/*
 * Lighting needs to know which half is holding a layer open, and the only place
 * that is known for certain is the behaviour that opens it. A shield asks for
 * the recording momentary-layer driver by defining LAYER_OWNER_PRESENT; without
 * it, ZMK's own behaviour stands.
 *
 * Kept separate from RGBZONE_PRESENT, which means specifically "the rgbzone
 * shield is here" and gates that shield's own behaviour nodes (rgbz_up and
 * friends). rgbkey wants the owner mechanism WITHOUT those nodes -- defining
 * RGBZONE_PRESENT to get it fails the build on an undefined rgbz_up label.
 */
#if defined(RGBZONE_PRESENT) || defined(LAYER_OWNER_PRESENT)
&mo {
    compatible = "zmk,behavior-rgbzone-momentary";
};
#endif

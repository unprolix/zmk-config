## config/dts/bindings/serial/zmk,pico-uart-pio-half-duplex.yaml
```yaml
# Copyright (c) 2026 The ZMK Contributors
# SPDX-License-Identifier: MIT

description: |
  Single-wire half-duplex UART on an RP2040 PIO block.

  The Corne v4 links its two halves with a single data conductor on the interlink
  jack, so one GPIO has to both drive and sample the line. Zephyr's stock
  raspberrypi,pico-uart-pio takes a separate tx pin and rx pin and leaves the
  tx pin permanently configured as an output; pointing both at the same GPIO
  therefore ends with the pin stuck in whichever direction initialised last,
  and the two halves fight over the line.

  This driver keeps the pin an input (idle-high on its pull-up) and flips it
  to an output only for as long as it is actually transmitting. The receive
  state machine is stopped while transmitting, so a half never hears its own
  output.

  The pinctrl group must name exactly one pin and be called "data_pins". It
  should set input-enable and bias-pull-up, since the pin spends most of its
  life receiving.

  Only the polling UART API is implemented, which is what
  CONFIG_ZMK_SPLIT_WIRED_UART_MODE_POLLING needs.

compatible: "zmk,pico-uart-pio-half-duplex"

include: [uart-controller.yaml, "raspberrypi,pico-pio-device.yaml"]

properties:
  turnaround-delay-us:
    type: int
    default: 200
    description: |
      How long the line may sit idle after the last transmitted byte before
      the driver hands it back to the receiver on its own.

      The driver already returns to receive mode on the first read after a
      transmission, so this only matters when the other half stops reading
      after it replies. Rounded up to a whole system tick.
```

## config/dts/bindings/zmk,boot-key.yaml
```yaml
# Copyright (c) 2026 The ZMK Contributors
# SPDX-License-Identifier: MIT

description: |
  A key that, held while the board powers up, reboots it into the bootloader.

  ZMK's own &bootloader behaviour is a keymap binding, so it needs the keymap
  running to reach it -- and on a split peripheral it needs the link to the
  central as well, since the peripheral does not run a keymap at all. That
  leaves nothing at all for a peripheral whose split link does not work, which
  on a board with no reachable BOOT button means no way back.

  This is the same idea as QMK's bootmagic and runs in its place: one GPIO,
  read once at startup, before the keymap, the split transport or USB exist.
  It works on firmware that is otherwise completely broken. The only thing it
  needs is that the board boots far enough to run SYS_INIT.

  Requires CONFIG_RETENTION_BOOT_MODE, which is how the reboot is told to stop
  in the bootloader rather than come back up in the application.

compatible: "zmk,boot-key"

properties:
  gpios:
    type: phandle-array
    required: true
    description: |
      The key to check, as it is wired -- normally active-low with a pull-up,
      the same as every other switch on the board.
```

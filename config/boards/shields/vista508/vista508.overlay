/*
 * Vista508 — Sharp memory-in-pixel display, 144x168, on the Rolio left half.
 *
 * Uses the vendor's zmk-ls0xxvcom-driver fork rather than Zephyr's in-tree
 * `sharp,ls0xx`. Both do software VCOM, but only the fork has `rotate-180`,
 * and this panel is mounted upside down. LVGL cannot rotate a 1-bit display
 * (lv_draw_sw_rotate covers L8/RGB565/RGB888/XRGB8888 but not I1), so the
 * rotation has to be done by the driver as it writes lines out.
 *
 * `vista508_spi` is provided by rolio_left.overlay (spi0, CS on P0.20).
 */

&vista508_spi {
    status = "okay";
    vista508: ls0xx@0 {
        compatible = "sharp,ls0xx-vcom";
        spi-max-frequency = <1000000>;
        reg = <0>;
        width = <144>;
        height = <168>;
        serial-vcom-inversion;
        serial-vcom-interval = <17>;
        rotate-180;
        /*
         * One SPI transaction per frame instead of one per LINE. Without this
         * the driver walks the panel a row at a time, so a full redraw is 168
         * transactions and 168 CPU wakeups; with it the CPU sets up the
         * transfer and goes back to deep sleep while EasyDMA does the rest.
         *
         * Only works because vista508_spi is spi0 declared as
         * `nordic,nrf-spim` (rolio_left.overlay) -- plain `nordic,nrf-spi` has
         * no EasyDMA and the property silently does nothing. spi0/1/2 are also
         * the right choice over spi3, which needs the high-frequency clock and
         * costs 1-2 mA of base current on the nRF52840.
         *
         * Costs about 3.3 KB of SRAM: height * (width/8 + 2).
         *
         * Worth more here than it looks. The circle-cube animation repaints the
         * whole panel every 900 ms, so this is the difference between ~187 and
         * ~1.1 wakeups per second while it is on screen.
         */
        dma-mode;
    };
};

/ {
    chosen {
        zephyr,display = &vista508;
    };
};

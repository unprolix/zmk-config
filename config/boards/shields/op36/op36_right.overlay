#include "op36_halves.dtsi"

#define OP36_RIGHT_COL_OFFSET 6

&default_transform {
    col-offset = <OP36_RIGHT_COL_OFFSET>;
};

&kscan0 {
    col-gpios
        = <&gpio0 30 GPIO_ACTIVE_HIGH>
        , <&gpio0 29 GPIO_ACTIVE_HIGH>
        , <&gpio0 2 GPIO_ACTIVE_HIGH>
        , <&gpio1 13 GPIO_ACTIVE_HIGH>
        , <&gpio0 28 GPIO_ACTIVE_HIGH>
        , <&gpio0 3 GPIO_ACTIVE_HIGH>
        ;

    row-gpios
        = <&gpio1 9 (GPIO_ACTIVE_HIGH | GPIO_PULL_DOWN)>
        , <&gpio0 5 (GPIO_ACTIVE_HIGH | GPIO_PULL_DOWN)>
        , <&gpio1 10 (GPIO_ACTIVE_HIGH | GPIO_PULL_DOWN)>
        ;
};

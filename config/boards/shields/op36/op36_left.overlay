#include "op36_halves.dtsi"

/*
 * P0.09 and P0.10 are the nRF52840's NFC pins; the ergohaven board releases
 * them for GPIO use (&uicr nfct-pins-as-gpios).
 */
&kscan0 {
    col-gpios
        = <&gpio0 13 GPIO_ACTIVE_HIGH>
        , <&gpio0 24 GPIO_ACTIVE_HIGH>
        , <&gpio0 10 GPIO_ACTIVE_HIGH>
        , <&gpio0 3 GPIO_ACTIVE_HIGH>
        , <&gpio1 10 GPIO_ACTIVE_HIGH>
        , <&gpio1 11 GPIO_ACTIVE_HIGH>
        ;

    row-gpios
        = <&gpio1 9 (GPIO_ACTIVE_HIGH | GPIO_PULL_DOWN)>
        , <&gpio0 5 (GPIO_ACTIVE_HIGH | GPIO_PULL_DOWN)>
        , <&gpio0 9 (GPIO_ACTIVE_HIGH | GPIO_PULL_DOWN)>
        ;
};

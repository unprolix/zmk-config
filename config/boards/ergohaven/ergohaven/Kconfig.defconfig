## config/boards/ergohaven/ergohaven/Kconfig.defconfig
```kconfig
# SPDX-License-Identifier: MIT

if BOARD_ERGOHAVEN

if USB_DEVICE_STACK

config USB_NRFX
    default y

endif # USB_DEVICE_STACK

config BT_CTLR
    default BT

endif # BOARD_ERGOHAVEN
```

## config/boards/ergohaven/ergohaven/board.yml
```yaml
board:
  name: ergohaven
  full_name: Ergohaven E73 nRF52840
  vendor: ergohaven
  socs:
    - name: nrf52840
      variants:
        - name: zmk
```

## config/boards/rolio/rolio3/Kconfig.defconfig
```kconfig
# SPDX-License-Identifier: MIT

if BOARD_ROLIO3

if USB_DEVICE_STACK

config USB_NRFX
    default y

endif # USB_DEVICE_STACK

config BT_CTLR
    default BT

endif # BOARD_ROLIO3
```

## config/boards/rolio/rolio3/Kconfig.rolio3
```kconfig
# Rolio Core V3 board configuration
#
# SPDX-License-Identifier: MIT

config BOARD_ROLIO3
    select SOC_NRF52840_QIAA
    select ZMK_BOARD_COMPAT
    imply RETAINED_MEM
    imply RETENTION
    imply RETENTION_BOOT_MODE
```

## config/boards/rolio/rolio3/board.yml
```yaml
board:
  name: rolio3
  full_name: Rolio Core V3
  vendor: rolio
  socs:
    - name: nrf52840
      variants:
        - name: zmk
```

## config/boards/shields/op36/Kconfig.shield
```kconfig
config SHIELD_OP36_LEFT
    def_bool $(shields_list_contains,op36_left)

config SHIELD_OP36_RIGHT
    def_bool $(shields_list_contains,op36_right)

config SHIELD_OP36_QUBE
    def_bool $(shields_list_contains,op36_qube)
```

## config/boards/shields/op36_pinscan/Kconfig.shield
```kconfig
# DIAGNOSTIC ONLY. See pinscan.c.
config SHIELD_OP36_PINSCAN
    def_bool $(shields_list_contains,op36_pinscan)
```

## config/boards/shields/rolio/Kconfig.defconfig
```kconfig
# SPDX-License-Identifier: MIT

if SHIELD_ROLIO_LEFT

config ZMK_KEYBOARD_NAME
    default "Rolio Three"

config ZMK_SPLIT_ROLE_CENTRAL
    default y

endif # SHIELD_ROLIO_LEFT

if SHIELD_ROLIO_LEFT || SHIELD_ROLIO_RIGHT

config ZMK_SPLIT
    default y

config ZMK_POINTING
    default y

endif

if ZMK_BACKLIGHT

# The "backlight" PWM channel gates power to the underglow strip.
config PWM
    default y

config LED_PWM
    default y

endif # ZMK_BACKLIGHT
```

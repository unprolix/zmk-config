// todo: some preprocess scripting to make this nicer to read and maintain

#define ARCANE_DELAY 650


#define ARCANE_EXPANSION(name, ...) \
    arcane_##name: arcane_##name { \
        compatible = "zmk,behavior-macro"; \
        #binding-cells = <0>; \
        bindings = __VA_ARGS__; \
    };



ARCANE_EXPANSION(a, <&kp N>, <&kp D>)
ARCANE_EXPANSION(b, <&kp E>, <&kp C>, <&kp A>, <&kp U>, <&kp S>, <&kp E>)
ARCANE_EXPANSION(c, <&kp A>, <&kp N>)
ARCANE_EXPANSION(g, <&kp E>, <&kp N>, <&kp E>, <&kp R>, <&kp A>, <&kp L>)
ARCANE_EXPANSION(i, <&kp N>, <&kp G>)
ARCANE_EXPANSION(j, <&kp U>, <&kp S>, <&kp T>)
ARCANE_EXPANSION(m, <&kp M>, <&kp E>, <&kp N>, <&kp T>)
ARCANE_EXPANSION(n, <&kp I>, <&kp O>, <&kp N>)
ARCANE_EXPANSION(p, <&kp A>, <&kp S>)
ARCANE_EXPANSION(q, <&kp U>, <&kp E>)
ARCANE_EXPANSION(t, <&kp I>, <&kp O>, <&kp N>)
ARCANE_EXPANSION(v, <&kp E>, <&kp R>, <&kp S>, <&kp I>, <&kp O>, <&kp N>)
ARCANE_EXPANSION(w, <&kp H>, <&kp I>, <&kp C>, <&kp H>)
ARCANE_EXPANSION(y, <&kp E>, <&kp A>, <&kp H>)

// to consider: special values for non-alphabetic keys


arcane_left_default: arcane_left_default {
        compatible = "zmk,behavior-mod-morph";
        #binding-cells = <0>;
        bindings = <&sk LSHIFT>, <&caps_word>;
        mods = <(MOD_LSFT|MOD_RSFT)>;
};
 
arcane_right_default: arcane_right_default {
        compatible = "zmk,behavior-mod-morph";
        #binding-cells = <0>;
        bindings = <&sk RSHIFT>, <&caps_word>;
        mods = <(MOD_LSFT|MOD_RSFT)>;
};
 
arcane_left: arcane_left {
        compatible = "zmk,behavior-antecedent-morph";
        #binding-cells = <0>;
        defaults = <&arcane_left_default>;
	bindings = <&key_repeat>, <&arcane_b>, <&arcane_c>, <&key_repeat>, <&key_repeat>, <&key_repeat>, <&arcane_g>, <&key_repeat>, <&key_repeat>, <&arcane_j>, <&key_repeat>, <&key_repeat>, <&arcane_m>, <&arcane_n>, <&key_repeat>, <&key_repeat>, <&key_repeat>, <&key_repeat>, <&key_repeat>, <&arcane_t>, <&key_repeat>, <&arcane_v>, <&arcane_w>, <&key_repeat>, <&key_repeat>, <&key_repeat>;
        antecedents = <A B C D E F G H I J K L M N O P Q R S T U V W X Y Z>;
        max-delay-ms = <ARCANE_DELAY>;
};

arcane_right: arcane_right {
        compatible = "zmk,behavior-antecedent-morph";
        #binding-cells = <0>;
        defaults = <&arcane_right_default>;
	bindings = <&arcane_a>, <&key_repeat>, <&key_repeat>, <&key_repeat>, <&key_repeat>, <&key_repeat>, <&key_repeat>, <&key_repeat>, <&arcane_i>, <&key_repeat>, <&key_repeat>, <&key_repeat>, <&key_repeat>, <&key_repeat>, <&key_repeat>, <&arcane_p>, <&arcane_q>, <&key_repeat>, <&key_repeat>, <&key_repeat>, <&key_repeat>, <&key_repeat>, <&key_repeat>, <&key_repeat>, <&arcane_y>, <&key_repeat>;
        antecedents = <A B C D E F G H I J K L M N O P Q R S T U V W X Y Z>;
        max-delay-ms = <ARCANE_DELAY>;
};
